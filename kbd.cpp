#include <cstdint>
#include <compat.h>
#include <debugging.h>

#include "kbd.h"

// http://www.6502.org/users/andre/petindex/keyboards.html

// maps scan codes to pet rows/cols (graphics keyboard)
static const uint8_t scanmap[128] PROGMEM = {
	0xff, 0xff, 0xff, 0xff, 0xff, 0xff, 0xff, 0xff, // 0x00
	0xff, 0xff, 0xff, 0xff, 0xff, 0xff, 0xff, 0xff, // 0x08
	0xff, 0xff, 0x80, 0xff, 0xff, 0x20, 0x00, 0xff, // 0x10
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	0xff, 0x77, 0x67, 0x87, 0x57, 0x27, 0xff, 0xff, // 0x78
};

// accessed by R-Shift
static const uint8_t shiftmap[128] PROGMEM = {
	0xff, 0xff, 0xff, 0xff, 0xff, 0xff, 0xff, 0xff, // 0x00
	0xff, 0xff, 0xff, 0xff, 0xff, 0xff, 0xff, 0xff, // 0x08
	0xff, 0xff, 0xff, 0xff, 0xff, 0xff, 0x00, 0xff, // 0x10
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	0xff, 0xff, 0xff, 0xff, 0xff, 0xff, 0xff, 0xff, // 0x78
};

// accessed by Ctrl
static const uint8_t ctrlmap[128] PROGMEM = {
	0xff, 0xff, 0xff, 0xff, 0xff, 0xff, 0xff, 0xff, // 0x00
	0xff, 0xff, 0xff, 0xff, 0xff, 0xff, 0xff, 0xff, // 0x08
	0xff, 0xff, 0xff, 0xff, 0xff, 0x16, 0xff, 0xff, // 0x10
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	0xff, 0xff, 0xff, 0xff, 0xff, 0xff, 0xff, 0xff, // 0x78
};

uint8_t kbd::_map(uint8_t scan) const {
	if (_shift)
		return pgm_read_byte(shiftmap + scan);

	if (_ctrl)
		return pgm_read_byte(ctrlmap + scan);

	return pgm_read_byte(scanmap + scan);
}
	
void kbd::_reset(uint8_t k) {
	_rows[(k & 0xf0) >> 4] &= ~(1 << (k & 0x0f));
}

void kbd::up(uint16_t scan) {

	DBG_EMU("key up: %04x", scan);

	if (scan == PS2_RSHIFT) {
		reset();		// reset any depressed keys so they don't get stuck
		_shift = false;
	} else if (is_ps2_ctrl(scan)) {
		reset();
		_ctrl = false;
	} else if (scan < 0x80)
		_reset(_map(scan));
	else if (scan & PS2_MOD_EXT) {
		switch(scan) {
		case PS2_END:
			_reset(0x80);	// fallthrough
		case PS2_HOME:
			_reset(0x06);
			break;
		case PS2_UP:
			_reset(0x80);	// fallthrough
		case PS2_DOWN:
			_reset(0x16);
			break;
		case PS2_LEFT:
			_reset(0x80);	// fallthrough
		case PS2_RIGHT:
			_reset(0x07);
			break;
		case PS2_INS:
			_reset(0x80);	// fallthrough
		case PS2_DEL:
			_reset(0x17);
			break;
		case PS2_KEYPAD_ENTER:
			_reset(_map(0x5a));
			break;
		case PS2_KEYPAD_SLASH:
			_reset(_map(0x4a));
			break;
		default:		// ignore other extended keys
			break;
		}
	}
}

void kbd::_set(uint8_t k) {
	_rows[(k & 0xf0) >> 4] |= 1 << (k & 0x0f);
}

void kbd::down(uint16_t scan) {

	DBG_EMU("key down: %04x", scan);

	if (scan == PS2_RSHIFT) {
		reset();		// reset any depressed keys so they don't get stuck
		_shift = true;
	} else if (is_ps2_ctrl(scan)) {
		reset();
		_ctrl = true;
	} else if (scan < 0x80)
		_set(_map(scan));
	else if (scan & PS2_MOD_EXT) {
		switch (scan) {
		case PS2_END:
			_set(0x80);	// fallthrough
		case PS2_HOME:
			_set(0x06);
			break;
		case PS2_UP:
			_set(0x80);	// fallthrough
		case PS2_DOWN:
			_set(0x16);
			break;
		case PS2_LEFT:
			_set(0x80);	// fallthrough
		case PS2_RIGHT:
			_set(0x07);
			break;
		case PS2_INS:
			_set(0x80);	// fallthrough
		case PS2_DEL:
			_set(0x17);
			break;
		case PS2_KEYPAD_ENTER:
			_set(_map(0x5a));
			break;
		case PS2_KEYPAD_SLASH:
			_set(_map(0x4a));
			break;
		default:		// ignore other extended keys
			break;
		}
	}
}

void kbd::reset() {
	for (int i = sizeof(_rows); i--; )
		_rows[i] = 0;
	_ctrl = _shift = false;
}
