#include <Arduino.h>
#include <stdint.h>
#include <keyboard.h>
#include "kbd.h"

// http://www.6502.org/users/andre/petindex/keyboards.html

// maps scan codes to pet rows/cols
// (map L-GUI to LSHIFT and R-GUI to RSHIFT)
static const uint8_t scanmap[128] PROGMEM = {
	0xff, 0xff, 0xff, 0xff, 0xff, 0xff, 0xff, 0xff, // 0x00
	0xff, 0xff, 0xff, 0xff, 0xff, 0xff, 0xff, 0xff, // 0x08
	0xff, 0xff, 0xff, 0xff, 0xff, 0x20, 0x66, 0xff, // 0x10
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	0xff, 0x77, 0x67, 0x87, 0x57, 0x27, 0xff, 0xff, // 0x78
};

static const uint8_t shiftmap[128] PROGMEM = {
	0xff, 0xff, 0xff, 0xff, 0xff, 0xff, 0xff, 0xff, // 0x00
	0xff, 0xff, 0xff, 0xff, 0xff, 0xff, 0xff, 0xff, // 0x08
	0xff, 0xff, 0xff, 0xff, 0xff, 0xff, 0x00, 0xff, // 0x10
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	0xff, 0xff, 0xff, 0xff, 0xff, 0xff, 0xff, 0xff, // 0x78
};

static const uint8_t ctrlmap[128] PROGMEM = {
	0xff, 0xff, 0xff, 0xff, 0xff, 0xff, 0xff, 0xff, // 0x00
	0xff, 0xff, 0xff, 0xff, 0xff, 0xff, 0xff, 0xff, // 0x08
	0xff, 0xff, 0xff, 0xff, 0xff, 0x16, 0xff, 0xff, // 0x10
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	0xff, 0xff, 0xff, 0xff, 0xff, 0xff, 0xff, 0xff, // 0x78
};

uint8_t kbd::_map(uint8_t scan) {
	if (_shift)
		return pgm_read_byte(shiftmap + scan);

	if (_ctrl)
		return pgm_read_byte(ctrlmap + scan);

	return pgm_read_byte(scanmap + scan);
}
	
void kbd::_reset(uint8_t k) {
	_rows[(k & 0xf0) >> 4] &= ~(1 << (k & 0x0f));
}

void kbd::up(uint8_t scan) {

#if defined(DEBUGGING)
	Serial.printf("key up: %02x", scan);
	Serial.println();
#endif
	if (_ext) {
		_ext = false;
		switch(scan) {
		case 0x69:	// end
			_reset(0x80);
		case 0x6c:	// home
			_reset(0x06);
			break;
		case 0x75:	// up
			_reset(0x80);
		case 0x72:	// down
			_reset(0x16);
			break;
		case 0x6b:	// left
			_reset(0x80);
		case 0x74:	// right
			_reset(0x07);
			break;
		case 0x70:	// ins
			_reset(0x80);
		case 0x71:	// del
			_reset(0x17);
			break;
		default:
			if (scan < 0x80)
				_reset(_map(scan));
			break;
		}
	} else if (isshift(scan))
		_shift = false;
	else if (isctrl(scan))
		_ctrl = false;
	else if (scan < 128) {
		uint8_t k = _map(scan);
		if (k != 0xff)
			_reset(k);
	}
}

void kbd::_set(uint8_t k) {
	_rows[(k & 0xf0) >> 4] |= 1 << (k & 0x0f);
}

void kbd::down(uint8_t scan) {
#if defined(DEBUGGING)
	Serial.printf("key down: %02x", scan);
	Serial.println();
#endif
	if (scan == 0xe0)
		_ext = true;
	else if (_ext) {
		_ext = false;
		switch(scan) {
		case 0x69:	// end
			_set(0x80);
		case 0x6c:	// home
			_set(0x06);
			break;
		case 0x75:	// up
			_set(0x80);
		case 0x72:	// down
			_set(0x16);
			break;
		case 0x6b:	// left
			_set(0x80);
		case 0x74:	// right
			_set(0x07);
			break;
		case 0x70:	// ins
			_set(0x80);
		case 0x71:	// del
			_set(0x17);
			break;
		default:
			if (scan < 0x80)
				_set(_map(scan));
		}
	} else if (isshift(scan)) {
		// reset any depressed keys so they don't get stuck
		reset();
		_shift = true;
	} else if (isctrl(scan)) {
		reset();
		_ctrl = true;
	} else if (scan < 128) {
		uint8_t k = _map(scan);
		if (k != 0xff)
			_set(k);
	}
}

void kbd::reset() {
	for (int i = sizeof(_rows); i--; )
		_rows[i] = 0;
	_ctrl = false;
	_shift = false;
}
